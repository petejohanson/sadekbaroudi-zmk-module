## boards/shields/sadekbaroudi_ffkb_lite/Kconfig.defconfig
```kconfig
# Copyright (c) 2023 The ZMK Contributors
# SPDX-License-Identifier: MIT

if SHIELD_SADEKBAROUDI_FFKB_LITE

config ZMK_KEYBOARD_NAME
    default "FFKB Lite"

endif
```

## boards/shields/sadekbaroudi_ffkb_lite/Kconfig.shield
```kconfig
# Copyright (c) 2023 The ZMK Contributors
# SPDX-License-Identifier: MIT

config SHIELD_SADEKBAROUDI_FFKB_LITE
    def_bool $(shields_list_contains,sadekbaroudi_ffkb_lite)
```

## boards/shields/vik_gc9a01a/Kconfig.shield
```kconfig
# Copyright (c) 2023 Pete Johanson
# SPDX-License-Identifier: Apache-2.0

config SHIELD_VIK_ST7735
	def_bool $(shields_list_contains,vik_st7735)
	imply ZMK_DISPLAY
```

## boards/shields/vik_st7735/Kconfig.defconfig
```kconfig
# Copyright (c) 2019 Linaro Limited
# SPDX-License-Identifier: Apache-2.0

if SHIELD_VIK_ST7735

if DISPLAY

if LVGL

config LV_Z_BITS_PER_PIXEL
	default 16

endif # LVGL

endif # DISPLAY

endif # SHIELD_VIK_ST7735
```

## west.yml
```yaml
manifest:
  remotes:
    - name: petejohanson
      url-base: https://github.com/petejohanson
  projects:
    - name: gc9a01a_zephyr_driver
      remote: petejohanson
      revision: main
      clone-depth: 1
```
